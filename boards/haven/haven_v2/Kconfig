## boards/haven/haven_v2/Kconfig
```kconfig
if BOARD_HAVEN_V2_NRF5340_CPUAPP

config DOMAIN_CPUNET_BOARD
	string
	default "haven_v2/nrf5340/cpunet"

endif # BOARD_HAVEN_V2_NRF5340_CPUAPP

if BOARD_HAVEN_V2_NRF5340_CPUNET

config DOMAIN_CPUAPP_BOARD
	string
	default "haven_v2/nrf5340/cpuapp"

endif # BOARD_HAVEN_V2_NRF5340_CPUNET
```

## boards/haven/haven_v2/Kconfig.defconfig
```kconfig
if BOARD_HAVEN_V2_NRF5340_CPUAPP

# Same partition handling as the openearable_v2 board (and Zephyr's nrf5340dk).
DT_CHOSEN_Z_CODE_PARTITION := zephyr,code-partition
DT_CHOSEN_Z_SRAM_PARTITION := zephyr,sram-secure-partition

if TRUSTED_EXECUTION_SECURE

config FLASH_LOAD_SIZE
	default $(dt_chosen_reg_size_hex,$(DT_CHOSEN_Z_CODE_PARTITION))

config SRAM_SIZE
	default $(dt_chosen_reg_size_int,$(DT_CHOSEN_Z_SRAM_PARTITION),0,K)

endif # TRUSTED_EXECUTION_SECURE

config BT_HCI_IPC
	default y if BT

config HEAP_MEM_POOL_ADD_SIZE_BOARD
	int
	default 4096 if BT_HCI_IPC

endif # BOARD_HAVEN_V2_NRF5340_CPUAPP
```

## boards/haven/haven_v2/Kconfig.haven_v2
```kconfig
config BOARD_HAVEN_V2
	select SOC_NRF5340_CPUAPP_QKAA if BOARD_HAVEN_V2_NRF5340_CPUAPP
	select SOC_NRF5340_CPUNET_QKAA if BOARD_HAVEN_V2_NRF5340_CPUNET
```

## boards/haven/haven_v2/board.yml
```yaml
board:
  name: haven_v2
  full_name: Haven v2 earbud
  vendor: haven
  socs:
  - name: nrf5340
```

## boards/haven/haven_v2/haven_v2_nrf5340_cpunet_defconfig
```kconfig
CONFIG_CLOCK_CONTROL_NRF_K32SRC_XTAL=y
CONFIG_CLOCK_CONTROL_NRF_K32SRC_20PPM=y

CONFIG_ARM_MPU=y
CONFIG_HW_STACK_PROTECTION=y
CONFIG_GPIO=y

# No UART on v2.
CONFIG_SERIAL=n
CONFIG_CONSOLE=n
```
